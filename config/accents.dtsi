// https://github.com/rafaelromao/keyboards/blob/ec7f58f8380f54c78ba007f021ed73066ad0b3ef/src/zmk/keyboards/zen/rafaelromao/features/accents.dtsi

/*
*
* Copyright (c) 2022 Rafael Romão
* SPDX-License-Identifier: MIT
*
*/

#include <behaviors.dtsi>
#include <dt-bindings/zmk/keys.h>
#include <dt-bindings/zmk/bt.h>
#include "keys_fr.h"

/ {
    #define ACCENTED_KEY(NAME, LABEL_U, LABEL_L, LABEL, KEY, DEAD_KEY) \
        ac_##NAME##_l: ac_##NAME##_l { \
            wait-ms = <0>; \
            tap-ms = <0>; \
            label = LABEL_L; \
            compatible = "zmk,behavior-macro"; \
            #binding-cells = <0>; \
            bindings \
                = <&macro_tap &kp DEAD_KEY> \
                , <&macro_tap &kp KEY>; \
        }; \
        ac_##NAME##_u: ac_##NAME##_u { \
            wait-ms = <0>; \
            tap-ms = <0>; \
            label = LABEL_U; \
            compatible = "zmk,behavior-macro"; \
            #binding-cells = <0>; \
            bindings \
                = <&macro_release &kp LSHFT> \
                , <&macro_tap &kp DEAD_KEY> \
                , <&macro_press &kp LSHFT> \
                , <&macro_tap &kp KEY> \
                , <&macro_release &kp LSHFT> \
                ; \
        }; \
        ac_##NAME: ac_##NAME { \
            label = LABEL; \
            compatible = "zmk,behavior-mod-morph"; \
            #binding-cells = <0>; \
            bindings = <&ac_##NAME##_l>, <&ac_##NAME##_u>; \
            mods = <(MOD_LSFT|MOD_RSFT)>; \
            keep-mods = <(MOD_LSFT|MOD_RSFT)>; \
        };

    accents {
        ACCENTED_KEY(agrv, "à", "À", "àÀ", US_A, US_DGRAVE)
        ACCENTED_KEY(egrv, "è", "È", "èÈ", US_E, US_DGRAVE)
        ACCENTED_KEY(ugrv, "ù", "Ù", "ùÙ", US_U, US_DGRAVE)
    };
};